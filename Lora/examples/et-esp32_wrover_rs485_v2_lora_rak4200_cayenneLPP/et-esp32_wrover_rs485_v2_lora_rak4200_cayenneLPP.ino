/*******************************************************************************
 * ET-ESP32(WROVER) RS485 V2 
 * Tools->Board:"ESP32 Wrover Module"
 *******************************************************************************
 * I2C Interface & I2C Bus
 * -> IO22                = I2C_SCL
 * -> IO21                = I2C_SDA
 * -> I2C RTC:DS3231      = I2C Address : 0x68:1100100(x)
 * -> I2C EEPROM 24LC16   = I2C Address : 0x50:1010000(x)
 * -> I2C ADC MCP3423     = I2C Address : 0x6D:1100101(x)
 * -> I2C Sensor:BME280   = I2C Address : 0x76:1110110(x)
 * -> I2C Sebsor:SHT31    = I2C Address : 0x44:1000100(x)/0x45:1010101(x)
 * SPI Interface SD Card
 * -> SD_CS               = IO4
 * -> SPI_MISO            = IO19
 * -> SPI_MOSI            = IO23
 * -> SPI_SCK             = IO18
 * UART2 RS485 Half Duplex Auto Direction
 * -> IO26                = RX2
 * -> IO27                = TX2
 * User Switch
 * -> IO36                = USER_SW
 * RTC Interrupt
 * -> IO39                = RTC_INT#
 *******************************************************************************/

/*******************************************************************************
 * This demo is only supported after RUI firmware version 3.0.0.13.X on RAK4200
 * Master Board Uart Receive buffer size at least 128 bytes. 
 *******************************************************************************/
  
//=================================================================================================
#include <Wire.h> 
//=================================================================================================

//=================================================================================================
// Start of Default Hardware : ET-ESP32(WROVER) RS485 V2
//=================================================================================================
// Remap Pin USART -> C:\Users\Admin\Documents\Arduino\hardware\espressif\esp32\cores\esp32\HardwareSerial.cpp
//                    C:\Users\Admin\AppData\Local\Arduino15\packages\esp32\hardware\esp32\1.0.0\cores\esp32\HardwareSerial.cpp
//=================================================================================================
#include <HardwareSerial.h>
//=================================================================================================
#define SerialDebug           Serial                                                              // USB Serial(Serial0)
//=================================================================================================
#define SerialRS485_RX_PIN    16
#define SerialRS485_TX_PIN    17
#define SerialRS485           Serial2                                                             // Serial2(IO16=TXD,IO17=RXD)
//=================================================================================================
#define SerialLora_RX_PIN     14
#define SerialLora_TX_PIN     27
#define SerialLora            Serial1                                                             // Serial1(IO27=TXD,IO14=RXD)
//=================================================================================================
#define LORA_RES_PIN          33                                                                  // ESP32-WROVER :IO33(LoRa-RESET)
#define LORA_RES_PRESS        LOW
#define LORA_RES_RELEASE      HIGH
//=================================================================================================
#define I2C_SCL_PIN           22                                                                  // ESP32-WROVER : IO22(SCL1)
#define I2C_SDA_PIN           21                                                                  // ESP32-WROVER : IO21(SDA1)
//=================================================================================================
#define LED_PIN               2                                                                   // ESP-WROVER  : IO2
#define LedON                 1
#define LedOFF                0
//=================================================================================================
#define USER_SW_PIN           36                                                                  // ESP32-WROVER :IO36
#define SW_PRESS              LOW
#define SW_RELEASE            HIGH 
//=================================================================================================
#define RTC_INT_PIN           39                                                                  // ESP32-WROVER :IO39
#define RTC_INT_ACTIVE        LOW
#define RTC_INT_DEACTIVE      HIGH 
//=================================================================================================
// End of Default Hardware : ET-ESP32(WROVER) RS485 V2
//=================================================================================================

//=================================================================================================
#include "RAK4200.h"
#include <stdio.h>
//=================================================================================================
#define WORK_MODE LoRaWAN                                                                         //  LoRaWAN or LoRaP2P
#define JOIN_MODE WAN_ABP                                                                         //  OTAA or ABP
//#define JOIN_MODE WAN_OTAA                                                                        //  OTAA or ABP
//=================================================================================================

//=================================================================================================
#if JOIN_MODE == WAN_OTAA
String DevEui = "";
String AppEui = "";
String AppKey = "";
//=================================================================================================
#else JOIN_MODE == WAN_ABP
String NwkSKey = "";
String AppSKey = "";
String DevAddr = "";
#endif
//=================================================================================================

//=================================================================================================
bool InitLoRaWAN(void);
//=================================================================================================
RAK4200 RakLoRa(SerialLora, SerialDebug);
//=================================================================================================

//=================================================================================================
// Payload (Hex)  03 67 01 10 05 67 00 FF
//=================================================================================================
// Data Channel  Type  Value
// 03 ⇒ 3  67 ⇒ Temperature  0110 = 272 ⇒ 27.2°C
// 05 ⇒ 5  67 ⇒ Temperature  00FF = 255 ⇒ 25.5°C
//=================================================================================================
char payload[128]= "03670110056700FF";
uint8_t *pbuf;
String ack = "";
//=================================================================================================

//=================================================================================================
#include "CayenneLPP.h"                                                                           // CayenneLPP Version:1.1.0
//=================================================================================================
CayenneLPP lpp(51);                                                                               // maximum payload size = 51 byte
//=================================================================================================

//=================================================================================================
float dummy_float_temperature;
float dummy_float_humidity;
//=================================================================================================
unsigned long lastGetLoraSendTime = 0;
//=================================================================================================


//=================================================================================================
// initial Lora WAN
//=================================================================================================
bool InitLoRaWAN(void)
{
  //===============================================================================================
  if(RakLoRa.rk_setJoinMode(JOIN_MODE))                                                           // set join_mode:ABP
  {
    //=============================================================================================
    if(RakLoRa.rk_setRegion(0))                                                                   // set region 0:AS923
    {
#if JOIN_MODE == OTAA
      //===========================================================================================
      //===========================================================================================
      if(RakLoRa.rk_setSendinterval(0))                                                           // set LoRa e Duty Cycle feature:enable
      {
        SerialDebug.println(F("LoRa Duty Cycle feature Disable"));   
      }
      //===========================================================================================
      //===========================================================================================
      if(RakLoRa.rk_initOTAA(DevEui, AppEui, AppKey))                                             // set ABP mode parameters
      {
        //=========================================================================================
        SerialDebug.println(F("RAK4200 Initial LoraWAN,AS923,OTAA Mode...Complete"));  
        //=========================================================================================
        return true;
        //=========================================================================================    
      }
      //===========================================================================================
      //===========================================================================================
      
#else JOIN_MODE == ABP
      //===========================================================================================
      //===========================================================================================
      if(RakLoRa.rk_setSendinterval(1))                                                           // set LoRa e Duty Cycle feature:enable
      {
        SerialDebug.println(F("LoRa Duty Cycle feature Enable"));   
      }
      //===========================================================================================
      //===========================================================================================
      if(RakLoRa.rk_initABP(DevAddr, NwkSKey, AppSKey))                                           // set ABP mode parameters
      {
        //=========================================================================================
        SerialDebug.println(F("RAK4200 Initial LoraWAN,AS923,ABP Mode...Complete"));  
        //=========================================================================================
        return true;
        //=========================================================================================    
      }
      //===========================================================================================
      //===========================================================================================
#endif
    }
    //=============================================================================================
  }
  //===============================================================================================
  return false;
  //===============================================================================================
}
//=================================================================================================
// initial Lora WAN
//=================================================================================================


void setup() 
{
  //===============================================================================================
  // Start of Initial Default Hardware : ET-ESP32(WROVER) RS485 V2
  //===============================================================================================
  pinMode(LED_PIN, OUTPUT);
  digitalWrite(LED_PIN, LedOFF);
  //===============================================================================================
  pinMode(USER_SW_PIN,INPUT_PULLUP);
  pinMode(RTC_INT_PIN,INPUT_PULLUP);
  //===============================================================================================
  pinMode(LORA_RES_PIN, OUTPUT);
  digitalWrite(LORA_RES_PIN, LORA_RES_RELEASE);
  //===============================================================================================
  Wire.begin(I2C_SDA_PIN,I2C_SCL_PIN);                                                      
  //===============================================================================================
  SerialDebug.begin(115200);
  while(!SerialDebug);
  //===============================================================================================
  SerialRS485.begin(9600, SERIAL_8N1, SerialRS485_RX_PIN, SerialRS485_TX_PIN);
  while(!SerialRS485);
  //===============================================================================================
  // End of Initial Default Hardware : ET-ESP32(WROVER) RS485 V2
  //===============================================================================================

  //===============================================================================================
  SerialDebug.println("Start Config RAK4200...");
  //===============================================================================================
  //===============================================================================================
  SerialLora.begin(115200, SERIAL_8N1, SerialLora_RX_PIN, SerialLora_TX_PIN);
  while(!SerialLora);
  //===============================================================================================
  digitalWrite(LORA_RES_PIN, LORA_RES_PRESS);                                                     // active Reset
  delay(1000);
  digitalWrite(LORA_RES_PIN, LORA_RES_RELEASE);                                                   // release Reset
  //===============================================================================================
  //===============================================================================================
  while(1)
  {
    //=============================================================================================
    ack = RakLoRa.rk_recvData();
    SerialDebug.println(ack);
    //=============================================================================================
    if(ack.indexOf("Initialization OK") >= 0)
    {
      break;
    }
    //=============================================================================================
  } 
  //===============================================================================================
  SerialDebug.println("RAK4200 Power on Ready...");
  //===============================================================================================

  //===============================================================================================
  RakLoRa.rk_getVersion();                                                                        // get RAK4200 firmware version
  SerialDebug.println(RakLoRa.rk_recvData());                                                     // print version number
  //===============================================================================================

  //===============================================================================================
  SerialDebug.println(F("Initial RAK4200...LoRa WAN"));
  //===============================================================================================
  // set join_mode:ABP
  // set region 0:AS923
  // set ABP mode parameters
  //     -> DevAddr
  //     -> NwkSKey
  //     -> AppSKey
  //===============================================================================================
  if(!InitLoRaWAN())                                                                              // init LoRaWAN
  {
    SerialDebug.println(F("Init error,please reset module.")); 
    while(1);
  }
  //===============================================================================================
  
  //===============================================================================================
  SerialDebug.println(F("Join RAK4200 to LoRaWAN...Start"));
  //===============================================================================================
  while(!RakLoRa.rk_joinLoRaNetwork(60))                                                          // Joining LoRaNetwork timeout 60s
  {
    SerialDebug.println();
    SerialDebug.println(F("Rejoin again after 5s..."));
    delay(5000);
  }
  //===============================================================================================
  SerialDebug.println(F("Join RAK4200 to LoRaWAN...Success"));
  //===============================================================================================

  //===============================================================================================
  if(!RakLoRa.rk_isConfirm(1))                                                                    // set LoRa data send package type:0->unconfirm, 1->confirm
  {
    SerialDebug.println(F("LoRa data send package set error,please reset module.")); 
    while(1);    
  }
  //===============================================================================================

  //===============================================================================================
  SerialDebug.println();
  SerialDebug.println("ET-ESP32(WROVER)RS485 V2.....Ready");
  //===============================================================================================

  //===============================================================================================
  dummy_float_temperature = 25.1;
  dummy_float_humidity = 51.2;
  //===============================================================================================
  lastGetLoraSendTime = millis()+(1000ul*60);
  //===============================================================================================
}

//=================================================================================================
// main loop
//=================================================================================================
void loop() 
{
  //===============================================================================================
  ack = RakLoRa.rk_recvData();                                                                    // wait result & timeout 2000mS
  if(ack.length() > 0)
  { 
    SerialDebug.println(ack);
  }
  //===============================================================================================
  
  //===============================================================================================
  // Start of Send Lora payload Service
  //===============================================================================================
  if((millis() - lastGetLoraSendTime) > (1000ul*60))                                              // 60-Second
  {
    //=============================================================================================
    SerialDebug.println();
    SerialDebug.println(F("==============================================="));
    SerialDebug.println(F("Start send data..."));
    //=============================================================================================
    
    //=============================================================================================
    // http s://ww w.thethingsnetwork.org/docs/devices/arduino/api/cayennelpp.html
    //=============================================================================================
    lpp.reset();
    //=============================================================================================
    lpp.addTemperature(1, dummy_float_temperature);
    lpp.addRelativeHumidity(2, dummy_float_humidity);
    //=============================================================================================
    lpp.addDigitalInput(3, 0);
    lpp.addDigitalOutput(4, 1);
    //=============================================================================================
    
    //=============================================================================================
    // convert lpp buffer to string hex
    // 0x03 0x67 0x01 0x10 -> 0x30(0) 0x33(3) 0x36(6) 0x37(7) 0x30(0) 0x31(1) 0x31(1) 0x30(0) 
    //=============================================================================================
    pbuf = lpp.getBuffer();
    //=============================================================================================
    for(int i=0; i<lpp.getSize(); i++)
    {
      sprintf(payload+i*2,"%02X",pbuf[i]);
    }
    //=============================================================================================
    payload[lpp.getSize()*2] = 0x00;
    //=============================================================================================
    SerialDebug.print("cayenne LPP packet size = ");
    SerialDebug.println(lpp.getSize());
    SerialDebug.print("prepared payload = ");
    SerialDebug.println(payload);
    //=============================================================================================
    
    //=============================================================================================
    // Start of Send payload to LoRa Gateway
    //=============================================================================================
    if(RakLoRa.rk_sendData(1, payload))
    {   
      //===========================================================================================
      digitalWrite(LED_PIN, LedON);                                                               // Start Send LoRa Indicator
      //===========================================================================================
      unsigned long timeout = millis();
      //===========================================================================================
      while(1)
      {
        //=========================================================================================
        ack = RakLoRa.rk_recvData();                                                              // wait result & timeout 2000mS
        //=========================================================================================
        if((ack.indexOf("OK") >= 0) || (ack.indexOf("ERROR:") >= 0))
        {
          //=======================================================================================
          SerialDebug.println(F("send payload....complete"));
          SerialDebug.println(F("==============================================="));
          break;
          //=======================================================================================
        }
        //=========================================================================================
        
        //=========================================================================================
        // timeout
        //=========================================================================================
        if((millis() - timeout) > (1000ul*30)) 
        {
          //=======================================================================================
          SerialDebug.println(F("send payload....Timeout"));
          SerialDebug.println(F("==============================================="));
          break;
          //=======================================================================================
        }
        //=========================================================================================
      }
      //===========================================================================================    
    }
    //=============================================================================================
    // End of Send payload to LoRa Gateway
    //=============================================================================================
    
    //=============================================================================================
    SerialDebug.println(F("Restart counter...60 Second for next Send new Payload"));
    SerialDebug.println(F("==============================================="));
    //=============================================================================================
    lastGetLoraSendTime = millis();
    //=============================================================================================
    digitalWrite(LED_PIN, LedOFF);                                                                // Stop Send LoRa Indicator
    //=============================================================================================
  } 
  //===============================================================================================
  // End of Send Lora payload Service
  //===============================================================================================
}
//=================================================================================================
// main loop
//=================================================================================================
